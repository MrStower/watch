const uint8_t font_small[] PROGMEM={
	0x20, 0x54, 0x54, 0x54, 0x78, //à 1
	0x3c, 0x4a, 0x4a, 0x49, 0x31, //á 2
	0x7c, 0x54, 0x54, 0x28, 0x00, //â 3
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	0x08, 0x54, 0x34, 0x14, 0x7c, //ÿ 32
};
//0xC0 * 5
const uint8_t font_small1[] PROGMEM={
	0x7e, 0x11, 0x11, 0x11, 0x7e,//À 33
	0x7f, 0x49, 0x49, 0x49, 0x33,//Á 34
	0x7f, 0x49, 0x49, 0x49, 0x36,//Â 35
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	0x66, 0x19, 0x09, 0x09, 0x7f,//ß 64
};
const uint8_t font36px_line0[] PROGMEM={
	// @0 '0' (22 pixels wide)
	0x00, 0x00, 0xF8, 0x00, 0x00, //                 #####
	0x00, 0x7F, 0xFF, 0xE0, 0x00, //          ##################
	0x03, 0xFF, 0xFF, 0xFC, 0x00, //       ########################
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	0x00, 0x3F, 0xFF, 0xC0, 0x00, //           ################

	// @110 '1' (12 pixels wide)
	0x00, 0x00, 0x00, 0x20, 0x00, //                            #
	0x00, 0x00, 0x00, 0x70, 0x00, //                           ###
	0x00, 0x00, 0x00, 0xF8, 0x00, //                          #####
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	0x7F, 0xFF, 0xFF, 0xFF, 0xE0, //  ###################################


	// @170 '2' (21 pixels wide)
	0x00, 0x00, 0x00, 0x00, 0x00,
	0x00, 0x00, 0x00, 0x00, 0x00,
	0x7C, 0x00, 0x00, 0x00, 0x00, //  ####
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	0x78, 0x00, 0x00, 0x00, 0x00, //  ####


	// @275 '3' (22 pixels wide)
	0x1E, 0x00, 0x00, 0x00, 0x00, //    ####                        
	0x3C, 0x00, 0x00, 0x03, 0x00, //   ####                        ##
	0x3C, 0x00, 0x00, 0x07, 0x80, //   ####                       ####
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	0x01, 0xFC, 0x00, 0x00, 0x00, //        #######


	// @385 '4' (26 pixels wide)
	0x00, 0xF8, 0x00, 0x00, 0x00, //         #####
	0x00, 0xFC, 0x00, 0x00, 0x00, //         ######
	0x00, 0xFE, 0x00, 0x00, 0x00, //         #######
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	0x00, 0xF0, 0x00, 0x00, 0x00, //         ####


	// @515 '5' (21 pixels wide)
	0x1E, 0x00, 0x00, 0x00, 0x00, //    ####
	0x3C, 0x00, 0x1F, 0x80, 0x00, //   ####             ######
	0x3C, 0x00, 0x3F, 0xFF, 0xE0, //   ####            #################
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	0x00, 0xFF, 0x00, 0x00, 0x00, //         ########


	// @620 '6' (21 pixels wide)
	0x00, 0x3F, 0xFC, 0x00, 0x00, //           ############
	0x01, 0xFF, 0xFF, 0xC0, 0x00, //        ###################
	0x07, 0xFF, 0xFF, 0xF0, 0x00, //      #######################
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	0x00, 0xFF, 0x00, 0x00, 0x00, //         ########


	// @725 '7' (23 pixels wide)
	0x00, 0x00, 0x00, 0x01, 0xE0, //                                ####
	0x00, 0x00, 0x00, 0x01, 0xE0, //                                ####
	0x00, 0x00, 0x00, 0x01, 0xE0, //                                ####
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	0x00, 0x00, 0x00, 0x03, 0xE0, //                               #####


	// @840 '8' (21 pixels wide)
	0x00, 0x00, 0x00, 0x00, 0x00,
	0x01, 0xF8, 0x00, 0x00, 0x00, //        ######
	0x07, 0xFE, 0x00, 0xFC, 0x00, //      ##########         ######
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	0x01, 0xF8, 0x00, 0x00, 0x00, //        ######


	// @945 '9' (21 pixels wide)
	0x00, 0x00, 0x0F, 0xF0, 0x00, //                     ########
	0x00, 0x00, 0x3F, 0xFC, 0x00, //                   ############
	0x00, 0x00, 0x7F, 0xFF, 0x00, //                  ###############
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	0x00, 0x03, 0xFF, 0xC0, 0x00, //               ############


	// @1050 ':' (6 pixels wide)
	0x07, 0xC0, 0x00, 0x7C, 0x00,//   #####               #####
	0x0F, 0xE0, 0x00, 0xFE, 0x00, // #######             #######
	0x0F, 0xE0, 0x00, 0xFE, 0x00, // #######             #######
	0x0F, 0xE0, 0x00, 0xFE, 0x00, // #######             #######
	0x0F, 0xE0, 0x00, 0xFE, 0x00, // #######             #######
	0x07, 0xC0, 0x00, 0x7C, 0x00, //  #####               #####
};

const uint8_t font8px[] PROGMEM={
	0x00, 0x00, 0x00, 0x00, 0x00,	//Space
	0x00, 0x00, 0x5f, 0x00, 0x00,    // 21 !
	0x00, 0x07, 0x00, 0x07, 0x00,    // 22 "
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	0x10, 0x08, 0x08, 0x10, 0x08,    // 7e ~
};
// 0xE0 * 5
void ascii(){
	for (uint16_t u = 0; u <= sizeof(font8px); u++){
		i2c_send_byte(EEP_ADDR, 0x0020 * 5 + u, pgm_read_byte(&font8px[u]));
		//shiftout(DATA, pgm_read_byte(&font8px[u]));
		_delay_ms(6);
	}
	/*for (uint16_t u = 0; u <= sizeof(font_small); u++){
		i2c_send_byte(EEP_ADDR, 0x00E0 * 5 + u, pgm_read_byte(&font_small[u]));
		//shiftout(DATA, pgm_read_byte(&font_small[u]));
		_delay_ms(6);
	}
	for (uint16_t u = 0; u <= sizeof(font_small1); u++){
		i2c_send_byte(EEP_ADDR, 0x00C0 * 5 + u, pgm_read_byte(&font_small1[u]));
		//shiftout(DATA, pgm_read_byte(&font_small1[u]));
		_delay_ms(6);
	}
	for (uint16_t u = 0; u <= sizeof(font36px_line0); u++){
		i2c_send_byte(EEP_ADDR, 0x0100 * 5 + u, pgm_read_byte(&font36px_line0[u]));
		//shiftout(DATA, pgm_read_byte(&font8px[u]));
		_delay_ms(6);
	}*/
}
	for (uint16_t u = 0; u <= sizeof(font8px); u++){
		i2c_send_byte(EEP_ADDR, 0x0021 * 5 + u, pgm_read_byte(&font8px[u]));
		//shiftout(DATA, pgm_read_byte(&font8px[u]));
		_delay_ms(6);
	}
	for (uint16_t u = 0; u <= sizeof(font_small); u++){
		i2c_send_byte(EEP_ADDR, 0x00E0 * 5 + u, pgm_read_byte(&font_small[u]));
		//shiftout(DATA, pgm_read_byte(&font_small[u]));
		_delay_ms(6);
	}
	for (uint16_t u = 0; u <= sizeof(font_small1); u++){
		i2c_send_byte(EEP_ADDR, 0x00C0 * 5 + u, pgm_read_byte(&font_small1[u]));
		//shiftout(DATA, pgm_read_byte(&font_small1[u]));
		_delay_ms(6);
	}
	for (uint16_t u = 0; u <= sizeof(font36px_line0); u++){
		i2c_send_byte(EEP_ADDR, 0x0100 * 5 + u, pgm_read_byte(&font36px_line0[u]));
		//shiftout(DATA, pgm_read_byte(&font8px[u]));
		_delay_ms(6);
	}
}
